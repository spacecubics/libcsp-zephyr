## CMakeLists.txt
```
# SPDX-License-Identifier: Apache-2.0

cmake_minimum_required(VERSION 3.13.1)

find_package(Zephyr REQUIRED HINTS $ENV{ZEPHYR_BASE})
project(speq)

target_sources(app PRIVATE
  src/main.c
  src/buffer.c
  src/crc32.c
  src/queue.c
  src/rdp_queue.c
)
```

## west.yml
```
manifest:

  projects:
    - name: zephyr
      url: https://github.com/zephyrproject-rtos/zephyr
      revision: main
      path: zephyr
      west-commands: scripts/west-commands.yml
      import:
        name-allowlist:
          - cmsis
          - cmsis_6

    - name: libcsp
      url: https://github.com/libcsp/libcsp
      revision: develop
      path: modules/lib/libcsp
```

## prj.conf
```kconfig
CONFIG_ZTEST=y
CONFIG_LIBCSP=y
```

## src/main.c
```c
/*
 * Copyright (c) 2022 Space Cubics, LLC.
 *
 * SPDX-License-Identifier: Apache-2.0
 */

#include <zephyr/ztest.h>
#include <csp/csp.h>

ZTEST(simple, test_simple_asert)
{
	zassert_true(1, "1 was false");
	zassert_false(0, "0 was true");
	zassert_is_null(NULL, "NULL was not NULL");
	zassert_not_null("foo", "\"foo\" was NULL");
	zassert_equal(1, 1, "1 was not equal to 1");
	zassert_equal_ptr(NULL, NULL, "NULL was not equal to NULL");
}

ZTEST_SUITE(simple, NULL, NULL, NULL, NULL, NULL);
```

## src/buffer.c
```c
/*
 * Copyright (c) 2024 Space Cubics, LLC.
 *
 * SPDX-License-Identifier: Apache-2.0
 */

#include <zephyr/ztest.h>
#include <csp/csp.h>

static void *setup(void)
{
	csp_init();
	return NULL;
}

ZTEST(buffer, test_buffer_count)
{
	csp_packet_t *packets[CSP_BUFFER_COUNT];
	int i;

	memset(packets, 0, sizeof(packets));

	zassert_true(csp_buffer_remaining() == CSP_BUFFER_COUNT);

	for (i = 0; i < CSP_BUFFER_COUNT; i++) {
		/* csp_buffer_get_always() is the only way to get all buffers */
		packets[i] = csp_buffer_get_always();
		zassert_true(packets[i] != NULL, NULL);
	}

	zassert_true(csp_buffer_remaining() == 0);

	for (i = 0; i < CSP_BUFFER_COUNT; i++) {
		csp_buffer_free(packets[i]);
	}

	zassert_true(csp_buffer_remaining() == CSP_BUFFER_COUNT);
}

ZTEST(buffer, test_buffer_over_allocate)
{
	csp_packet_t *packets[CSP_BUFFER_COUNT];
	csp_packet_t *p;
	int i;

	memset(packets, 0, sizeof(packets));

	for (i = 0; i < CSP_BUFFER_COUNT - 2; i++) {
		packets[i] = csp_buffer_get(0);
		zassert_true(packets[i] != NULL, NULL);
	}

	zassert_true(csp_buffer_remaining() == 2);
	p = csp_buffer_get(0);
	zassert_true(p == NULL, NULL);

	for (i = 0; i < CSP_BUFFER_COUNT; i++) {
		csp_buffer_free(packets[i]);
	}
}

ZTEST_SUITE(buffer, NULL, setup, NULL, NULL, NULL);
```

## src/queue.c
```c
/*
 * Copyright (c) 2024 Space Cubics, LLC.
 *
 * SPDX-License-Identifier: Apache-2.0
 */

#include <zephyr/ztest.h>
#include <csp/csp.h>

/* test enqueue, dequeue */
ZTEST(queue, test_queue_enqueue_dequeue_one)
{
	char item1[] = "abc";
	char item2[sizeof(item1)];

	int qlength = 10;
	int buf_size = qlength * sizeof(item1);
	char buf[buf_size];

	csp_queue_handle_t qh;
	csp_static_queue_t q;

	/* zero clear */
	memset(buf, 0, buf_size);
	memset(item2, 0, sizeof(item2));

	csp_init();

	/* create */
	qh = csp_queue_create_static(qlength, sizeof(item1), buf, &q);

	/* enqueue, dequeue */
	zassert_equal(csp_queue_enqueue(qh, item1, 1000), CSP_QUEUE_OK);
	zassert_equal(csp_queue_dequeue(qh, item2, 1000), CSP_QUEUE_OK);

	/* compare item1 & item2 */
	zassert_equal(memcmp(item1, item2, sizeof(item1)), 0);
}

/* test enqueue, dequeue when full */
ZTEST(queue, test_queue_enqueue_dequeue_full)
{
	char item1[] = "abc";
	char item2[sizeof(item1)];

	int qlength = 10;
	int buf_size = qlength * sizeof(item1);
	char buf[buf_size];

	csp_queue_handle_t qh;
	csp_static_queue_t q;

	/* zero clear */
	memset(buf, 0, buf_size);
	memset(item2, 0, sizeof(item2));

	csp_init();

	/* create */
	qh = csp_queue_create_static(qlength, sizeof(item1), buf, &q);

	/* enqueue to the limit */
	for (int i = 0; i < qlength; i++) {
		zassert_equal(csp_queue_enqueue(qh, item1, 1000), CSP_QUEUE_OK);
	}
	/* dequeue to the limit */
	for (int i = 0; i < qlength; i++) {
		zassert_equal(csp_queue_dequeue(qh, buf, 1000), CSP_QUEUE_OK);
	}
}

/* test when full, enqueue additionally */
ZTEST(queue, test_queue_enqueue_overflow)
{
	char item1[] = "abc";
	char item2[sizeof(item1)];

	int qlength = 10;
	int buf_size = qlength * sizeof(item1);
	char buf[buf_size];

	csp_queue_handle_t qh;
	csp_static_queue_t q;

	/* zero clear */
	memset(buf, 0, buf_size);
	memset(item2, 0, sizeof(item2));

	csp_init();

	/* create */
	qh = csp_queue_create_static(qlength, sizeof(item1), buf, &q);

	/* enqueue to the limit */
	for (int i = 0; i < qlength; i++) {
		zassert_equal(csp_queue_enqueue(qh, item1, 1000), CSP_QUEUE_OK);
	}

	/* The queue is full, so enqueue operation throws an error */
	zassert_equal(csp_queue_enqueue(qh, item1, 1000), CSP_QUEUE_ERROR);
}

/* test when empty, dequeue one more */
ZTEST(queue, test_queue_dequeue_underflow)
{
	char item1[] = "abc";
	char item2[sizeof(item1)];

	int qlength = 10;
	int buf_size = qlength * sizeof(item1);
	char buf[buf_size];

	csp_queue_handle_t qh;
	csp_static_queue_t q;

	/* zero clear */
	memset(buf, 0, buf_size);
	memset(item2, 0, sizeof(item2));

	csp_init();

	/* create */
	qh = csp_queue_create_static(qlength, sizeof(item1), buf, &q);

	/* The queue is empty, so dequeue operation throws an error */
	zassert_equal(csp_queue_dequeue(qh, item2, 1000), CSP_QUEUE_ERROR);
}

/* test queue_free for queue size */
ZTEST(queue, test_queue_size)
{
	char item1[] = "abc";
	char item2[sizeof(item1)];

	int qlength = 10;
	int buf_size = qlength * sizeof(item1);
	char buf[buf_size];

	csp_queue_handle_t qh;
	csp_static_queue_t q;
	int qsize;

	/* zero clear */
	memset(buf, 0, buf_size);
	memset(item2, 0, sizeof(item2));

	csp_init();

	/* create */
	qh = csp_queue_create_static(qlength, sizeof(item1), buf, &q);

	/* Before enqueue, size is 0 */
	qsize = csp_queue_size(qh);
	zassert_equal(qsize, 0);

	/* After enqueue, size is 1 */
	csp_queue_enqueue(qh, item1, 1000);
	zassert_equal(csp_queue_size(qh), qsize + 1);

	/* After dequeue, size is 1 */
	qsize = csp_queue_size(qh);
	csp_queue_dequeue(qh, item2, 1000);
	zassert_equal(csp_queue_size(qh), qsize - 1);
}

/* test queue_free for available size */
ZTEST(queue, test_queue_free)
{
	char item1[] = "abc";
	char item2[sizeof(item1)];

	int qlength = 10;
	int buf_size = qlength * sizeof(item1);
	char buf[buf_size];

	csp_queue_handle_t qh;
	csp_static_queue_t q;

	/* zero clear */
	memset(buf, 0, buf_size);
	memset(item2, 0, sizeof(item2));

	csp_init();

	/* create */
	qh = csp_queue_create_static(qlength, sizeof(item1), buf, &q);

	/* Before enqueue, the available size is qlength */
	zassert_equal(csp_queue_free(qh), qlength);

	/* After enqueue, the available size is qlength - 1. */
	csp_queue_enqueue(qh, item1, 1000);
	zassert_equal(csp_queue_free(qh), qlength - 1);

	/* After dequeue, the available size is qlength */
	csp_queue_dequeue(qh, item2, 1000);
	zassert_equal(csp_queue_free(qh), qlength);
}

ZTEST(queue, test_queue_emtpy)
{
	char item1[] = "abc";

	int qlength = 10;
	int buf_size = qlength * sizeof(item1);
	char buf[buf_size];

	csp_queue_handle_t qh;
	csp_static_queue_t q;

	/* zero clear */
	memset(buf, 0, buf_size);

	csp_init();

	/* create */
	qh = csp_queue_create_static(qlength, sizeof(item1), buf, &q);

	csp_queue_enqueue(qh, item1, 1000);
	csp_queue_enqueue(qh, item1, 1000);
	csp_queue_enqueue(qh, item1, 1000);
	csp_queue_enqueue(qh, item1, 1000);

	/* After enqueue, check the size */
	zassert_equal(4, csp_queue_size(qh));

	/* After empty, check the size */
	csp_queue_empty(qh);
	zassert_equal(0, csp_queue_size(qh));

	/* It's ok to call queue_empty on an empty queue */
	csp_queue_empty(qh);
	zassert_equal(0, csp_queue_size(qh));

	/* make it full */
	for (int i = 0; i < qlength; i++) {
		csp_queue_enqueue(qh, item1, 1000);
	}
	/* then empty it */
	csp_queue_empty(qh);
	zassert_equal(0, csp_queue_size(qh));
}

ZTEST_SUITE(queue, NULL, NULL, NULL, NULL, NULL);
```

## src/rdp_queue.c
```c
/*
 * Copyright (c) 2024 Space Cubics, LLC.
 *
 * SPDX-License-Identifier: Apache-2.0
 */

#include <zephyr/ztest.h>
#include <csp/csp.h>

#define QUEUE_SIZE_MAX (CSP_RDP_MAX_WINDOW * 2)

/** Connection types */
typedef enum {
	CONN_CLIENT = 0,
	CONN_SERVER = 1,
} csp_conn_type_t;

void csp_rdp_queue_init(void);
int csp_rdp_queue_tx_size(void);
int csp_rdp_queue_rx_size(void);
void csp_rdp_queue_tx_add(csp_conn_t * conn, csp_packet_t * packet);
void csp_rdp_queue_rx_add(csp_conn_t * conn, csp_packet_t * packet);
void csp_rdp_queue_flush(csp_conn_t * conn);
csp_conn_t * csp_conn_allocate(csp_conn_type_t type);
csp_packet_t * csp_rdp_queue_tx_get(csp_conn_t * conn);
csp_packet_t * csp_rdp_queue_rx_get(csp_conn_t * conn);

ZTEST(rdp_queue, test_rdp_queue_emtpy)
{
	csp_rdp_queue_init();
	zassert_equal(0, csp_rdp_queue_tx_size());
	zassert_equal(0, csp_rdp_queue_rx_size());
	zassert_is_null(csp_rdp_queue_tx_get(NULL));
	zassert_is_null(csp_rdp_queue_rx_get(NULL));
}

ZTEST(rdp_queue, test_rdp_queue_add_and_get)
{
	csp_packet_t *p1;
	csp_packet_t *p2;

	csp_rdp_queue_init();
	zassert_equal(0, csp_rdp_queue_tx_size());
	zassert_equal(0, csp_rdp_queue_rx_size());

	csp_buffer_init();
	p1 = csp_buffer_get(0);
	zassert_not_null(p1);
	csp_rdp_queue_tx_add(NULL, p1);
	zassert_equal(1, csp_rdp_queue_tx_size());

	p2 = csp_rdp_queue_tx_get(NULL);
	zassert_equal(0, csp_rdp_queue_tx_size());
	zassert_not_null(p2);
	printf("%p %p\n", p1, p2);
	zassert_equal_ptr(p1, p2);
}

/* test when queue size is 1 */
ZTEST(rdp_queue, test_rdp_queue_one)
{
	csp_packet_t *packet;

	/* create queue */
	csp_rdp_queue_init();
	zassert_equal(0, csp_rdp_queue_tx_size());

	/* create packet */
	csp_buffer_init();
	packet = csp_buffer_get(0);
	zassert_not_null(packet);

	/* add packets to queue */
	csp_rdp_queue_tx_add(NULL, packet);
	int size = csp_rdp_queue_tx_size();
	zassert_equal(1, size, "queue size is not 1. queue size is %d.", size);
}

/* enqueue and dequeue test  */
ZTEST(rdp_queue, test_rdp_queue_enqueue_dequeue)
{
	csp_packet_t *enqueue_packet;
	csp_packet_t *dequeue_packet;

	/* create queue */
	csp_rdp_queue_init();
	zassert_equal(0, csp_rdp_queue_tx_size());

	/* create packet */
	csp_buffer_init();
	enqueue_packet = csp_buffer_get(0);
	zassert_not_null(enqueue_packet);

	/* enqueue */
	csp_rdp_queue_tx_add(NULL, enqueue_packet);
	int size = csp_rdp_queue_tx_size();
	zassert_equal(1, size, "queue size is not 1. queue size is %d.", size);

	/* dequeue */
	dequeue_packet = csp_rdp_queue_tx_get(NULL);
	zassert_not_null(dequeue_packet);
	size = csp_rdp_queue_tx_size();
	zassert_equal(0, size, "queue size is not 0. queue size is %d.", size);
	zassert_equal_ptr(enqueue_packet, dequeue_packet);
}

/* test when queue size is max */
ZTEST(rdp_queue, test_rdp_queue_max)
{
	csp_packet_t *packet;

	/* create queue */
	csp_rdp_queue_init();
	zassert_equal(0, csp_rdp_queue_tx_size());

	/* enqueue until queue is filled */
	csp_buffer_init();
	for (int i = 0; i < QUEUE_SIZE_MAX; i++) {
		/* create packet */
		packet = csp_buffer_get(0);
		zassert_not_null(packet);

		/* enqueue */
		csp_rdp_queue_tx_add(NULL, packet);
		zassert_equal((i+1), csp_rdp_queue_tx_size());
	}

	int size = csp_rdp_queue_tx_size();
	zassert_equal(QUEUE_SIZE_MAX, size, "queue size is not max. queue size is %d.", size);

	/* can not add when queue size is max */
	packet = csp_buffer_get(0);
	zassert_not_null(packet);
	csp_rdp_queue_tx_add(NULL, packet);

	size = csp_rdp_queue_tx_size();
	zassert_equal(QUEUE_SIZE_MAX, size, "queue size is not max. queue size is %d.", size);
}

/* queue up to max, then dequeue all */
ZTEST(rdp_queue, test_rdp_enqueue_max_and_dequeue)
{
	csp_packet_t *packet;

	/* create queue */
	csp_rdp_queue_init();
	zassert_equal(0, csp_rdp_queue_tx_size());

	/* enqueue until queue is filled */
	csp_buffer_init();
	for (int i = 0; i < QUEUE_SIZE_MAX; i++) {
		/* create packet */
		packet = csp_buffer_get(0);
		zassert_not_null(packet);

		/* enqueue */
		csp_rdp_queue_tx_add(NULL, packet);
		zassert_equal((i+1), csp_rdp_queue_tx_size());
	}

	int size = csp_rdp_queue_tx_size();
	zassert_equal(QUEUE_SIZE_MAX, size, "queue size is not max. queue size is %d.", size);

	/* dequeue all */
	for (int i = QUEUE_SIZE_MAX; i > 0; i--) {
		/* dequeue packet */
		packet = csp_rdp_queue_tx_get(NULL);
		zassert_not_null(packet);
		zassert_equal((i-1), csp_rdp_queue_tx_size());
	}

	size = csp_rdp_queue_tx_size();
	zassert_equal(0, size, "queue size is not 0. queue size is %d.", size);

	/* can not dequeue when queue size is 0 */
	packet = csp_rdp_queue_tx_get(NULL);
	zassert_is_null(packet);
	size = csp_rdp_queue_tx_size();
	zassert_equal(0, size, "queue size is not 0. queue size is %d.", size);
}

/* queue flush test */
ZTEST(rdp_queue, test_rdp_queue_flush)
{
	csp_conn_t *conn;
	csp_packet_t *packet_tx;
	csp_packet_t *packet_rx;

	csp_init();

	/* create connection */
	conn = csp_conn_allocate(CONN_CLIENT);

	/* create packet */
	packet_tx = csp_buffer_get(0);
	packet_rx = csp_buffer_get(0);
	zassert_not_null(packet_tx);
	zassert_not_null(packet_rx);

	/* enqueue */
	zassert_equal(0, csp_rdp_queue_tx_size());
	zassert_equal(0, csp_rdp_queue_rx_size());

	csp_rdp_queue_tx_add(conn, packet_tx);
	int size = csp_rdp_queue_tx_size();
	zassert_equal(1, size, "tx_queue size is not 1. tx_queue size is %d.", size);

	csp_rdp_queue_rx_add(conn, packet_rx);
	size = csp_rdp_queue_rx_size();
	zassert_equal(1, size, "rx_queue size is not 1. rx_queue size is %d.", size);

	/* queue flush */
	csp_rdp_queue_flush(conn);

	size = csp_rdp_queue_tx_size();
	zassert_equal(0, size, "tx_queue size is not 0. tx_queue size is %d.", size);

	size = csp_rdp_queue_rx_size();
	zassert_equal(0, size, "rx_queue size is not 0. rx_queue size is %d.", size);
}

ZTEST_SUITE(rdp_queue, NULL, NULL, NULL, NULL, NULL);
```
